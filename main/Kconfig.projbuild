## main/Kconfig.projbuild
```kconfig
menu "Debug Mode"

    config DEBUG_ENABLE
        bool "Enable debug mode"
        default n
        help
            Master switch for all debug features below.
            Enables APDU tracing, performance markers, and other instrumentation.

    if DEBUG_ENABLE

        config DEBUG_APDU_HEX
            bool "APDU hex trace"
            default y
            help
                Print raw hex dumps of all incoming APDUs and outgoing
                responses to the serial console.  Useful for debugging
                CTAP / CCID command flows.

        config DEBUG_PERF
            bool "Performance timing markers"
            default y
            help
                Print elapsed-time markers around long operations:
                key derivation, ECDSA signing, flash commits, etc.
                Times are printed via ESP_LOGI with the "perf" tag.

        config DEBUG_STACK
            bool "Stack high-water monitoring"
            default n
            help
                Periodically print the minimum free stack bytes for
                core0_loop and any worker task.  Helps catch stack
                overflows during development.

        config DEBUG_WDT_FEED
            bool "Feed hardware WDT during long loops"
            default n
            help
                Call esp_task_wdt_reset() inside long-running loops
                (scalar multiplication, flash bulk writes) so the
                hardware watchdog does not fire during operations
                that take > 10 s.  Required on the ed25519 branch
                where signing can take ~8 s.

        if DEBUG_WDT_FEED

            config DEBUG_WDT_FEED_INTERVAL_MS
                int "WDT feed interval (ms)"
                range 100 5000
                default 500
                help
                    How often esp_task_wdt_reset() is called inside
                    long loops.  Lower values are safer but add
                    overhead.

        endif # DEBUG_WDT_FEED

    endif # DEBUG_ENABLE

endmenu
```

## sdkconfig.defaults
```kconfig
# ESP32-FIDO2 Project Configuration
#
IGNORE_UNKNOWN_FILES_FOR_MANAGED_COMPONENTS=1

CONFIG_TINYUSB=y
CONFIG_TINYUSB_TASK_STACK_SIZE=16384

CONFIG_PARTITION_TABLE_CUSTOM=y
CONFIG_PARTITION_TABLE_CUSTOM_FILENAME="partitions.csv"
CONFIG_PARTITION_TABLE_FILENAME="partitions.csv"
CONFIG_ESPTOOLPY_FLASHSIZE_16MB=y
CONFIG_ESPTOOLPY_FLASHMODE_QIO=y
CONFIG_ESP_DEFAULT_CPU_FREQ_MHZ_240=y
CONFIG_WL_SECTOR_SIZE_512=y
CONFIG_WL_SECTOR_MODE_PERF=y
CONFIG_ESP_COREDUMP_ENABLE_TO_NONE=y

# Disable USB-Serial-JTAG (temporary, re-enable for debugging)
CONFIG_USJ_ENABLE_USB_SERIAL_JTAG=n
CONFIG_ESP_CONSOLE_SECONDARY_USB_SERIAL_JTAG=n
CONFIG_ESP_CONSOLE_USB_SERIAL_JTAG_ENABLED=n

# mbedTLS
CONFIG_MBEDTLS_CMAC_C=y
CONFIG_MBEDTLS_CHACHA20_C=y
CONFIG_MBEDTLS_POLY1305_C=y
CONFIG_MBEDTLS_CHACHAPOLY_C=y
CONFIG_MBEDTLS_HKDF_C=y
CONFIG_MBEDTLS_HARDWARE_ECC=y
CONFIG_MBEDTLS_HARDWARE_MPI=y
CONFIG_MBEDTLS_HARDWARE_GCM=y
CONFIG_MBEDTLS_DES_C=y
CONFIG_MBEDTLS_HARDWARE_SHA=y
CONFIG_MBEDTLS_HARDWARE_AES=y
CONFIG_MBEDTLS_SHA512_C=y
CONFIG_MBEDTLS_TLS_DISABLED=y

# Disable unused features
CONFIG_ESP_WIFI_ENABLED=n
CONFIG_ESP_TLS_USE_DS_PERIPHERAL=n
CONFIG_MBEDTLS_SHA3_C=y
```
